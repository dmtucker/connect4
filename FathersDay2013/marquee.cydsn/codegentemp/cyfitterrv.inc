    IF :LNOT::DEF:INCLUDED_CYFITTERRV_INC
INCLUDED_CYFITTERRV_INC EQU 1
    GET cydevicerv.inc
    GET cydevicerv_trm.inc

; ADC_Ext_CP_Clk
ADC_Ext_CP_Clk__CFG0 EQU CYREG_CLKDIST_DCFG0_CFG0
ADC_Ext_CP_Clk__CFG1 EQU CYREG_CLKDIST_DCFG0_CFG1
ADC_Ext_CP_Clk__CFG2 EQU CYREG_CLKDIST_DCFG0_CFG2
ADC_Ext_CP_Clk__CFG2_SRC_SEL_MASK EQU 0x07
ADC_Ext_CP_Clk__INDEX EQU 0x00
ADC_Ext_CP_Clk__PM_ACT_CFG EQU CYREG_PM_ACT_CFG2
ADC_Ext_CP_Clk__PM_ACT_MSK EQU 0x01
ADC_Ext_CP_Clk__PM_STBY_CFG EQU CYREG_PM_STBY_CFG2
ADC_Ext_CP_Clk__PM_STBY_MSK EQU 0x01

; Timer_TimerHW
Timer_TimerHW__CAP0 EQU CYREG_TMR0_CAP0
Timer_TimerHW__CAP1 EQU CYREG_TMR0_CAP1
Timer_TimerHW__CFG0 EQU CYREG_TMR0_CFG0
Timer_TimerHW__CFG1 EQU CYREG_TMR0_CFG1
Timer_TimerHW__CFG2 EQU CYREG_TMR0_CFG2
Timer_TimerHW__CNT_CMP0 EQU CYREG_TMR0_CNT_CMP0
Timer_TimerHW__CNT_CMP1 EQU CYREG_TMR0_CNT_CMP1
Timer_TimerHW__PER0 EQU CYREG_TMR0_PER0
Timer_TimerHW__PER1 EQU CYREG_TMR0_PER1
Timer_TimerHW__PM_ACT_CFG EQU CYREG_PM_ACT_CFG3
Timer_TimerHW__PM_ACT_MSK EQU 0x01
Timer_TimerHW__PM_STBY_CFG EQU CYREG_PM_STBY_CFG3
Timer_TimerHW__PM_STBY_MSK EQU 0x01
Timer_TimerHW__RT0 EQU CYREG_TMR0_RT0
Timer_TimerHW__RT1 EQU CYREG_TMR0_RT1
Timer_TimerHW__SR0 EQU CYREG_TMR0_SR0

; ADC_theACLK
ADC_theACLK__CFG0 EQU CYREG_CLKDIST_ACFG0_CFG0
ADC_theACLK__CFG1 EQU CYREG_CLKDIST_ACFG0_CFG1
ADC_theACLK__CFG2 EQU CYREG_CLKDIST_ACFG0_CFG2
ADC_theACLK__CFG2_SRC_SEL_MASK EQU 0x07
ADC_theACLK__CFG3 EQU CYREG_CLKDIST_ACFG0_CFG3
ADC_theACLK__CFG3_PHASE_DLY_MASK EQU 0x0F
ADC_theACLK__INDEX EQU 0x00
ADC_theACLK__PM_ACT_CFG EQU CYREG_PM_ACT_CFG1
ADC_theACLK__PM_ACT_MSK EQU 0x01
ADC_theACLK__PM_STBY_CFG EQU CYREG_PM_STBY_CFG1
ADC_theACLK__PM_STBY_MSK EQU 0x01

; LCD_LCDPort
LCD_LCDPort__0__MASK EQU 0x01
LCD_LCDPort__0__PC EQU CYREG_PRT2_PC0
LCD_LCDPort__0__PORT EQU 2
LCD_LCDPort__0__SHIFT EQU 0
LCD_LCDPort__1__MASK EQU 0x02
LCD_LCDPort__1__PC EQU CYREG_PRT2_PC1
LCD_LCDPort__1__PORT EQU 2
LCD_LCDPort__1__SHIFT EQU 1
LCD_LCDPort__2__MASK EQU 0x04
LCD_LCDPort__2__PC EQU CYREG_PRT2_PC2
LCD_LCDPort__2__PORT EQU 2
LCD_LCDPort__2__SHIFT EQU 2
LCD_LCDPort__3__MASK EQU 0x08
LCD_LCDPort__3__PC EQU CYREG_PRT2_PC3
LCD_LCDPort__3__PORT EQU 2
LCD_LCDPort__3__SHIFT EQU 3
LCD_LCDPort__4__MASK EQU 0x10
LCD_LCDPort__4__PC EQU CYREG_PRT2_PC4
LCD_LCDPort__4__PORT EQU 2
LCD_LCDPort__4__SHIFT EQU 4
LCD_LCDPort__5__MASK EQU 0x20
LCD_LCDPort__5__PC EQU CYREG_PRT2_PC5
LCD_LCDPort__5__PORT EQU 2
LCD_LCDPort__5__SHIFT EQU 5
LCD_LCDPort__6__MASK EQU 0x40
LCD_LCDPort__6__PC EQU CYREG_PRT2_PC6
LCD_LCDPort__6__PORT EQU 2
LCD_LCDPort__6__SHIFT EQU 6
LCD_LCDPort__AG EQU CYREG_PRT2_AG
LCD_LCDPort__AMUX EQU CYREG_PRT2_AMUX
LCD_LCDPort__BIE EQU CYREG_PRT2_BIE
LCD_LCDPort__BIT_MASK EQU CYREG_PRT2_BIT_MASK
LCD_LCDPort__BYP EQU CYREG_PRT2_BYP
LCD_LCDPort__CTL EQU CYREG_PRT2_CTL
LCD_LCDPort__DM0 EQU CYREG_PRT2_DM0
LCD_LCDPort__DM1 EQU CYREG_PRT2_DM1
LCD_LCDPort__DM2 EQU CYREG_PRT2_DM2
LCD_LCDPort__DR EQU CYREG_PRT2_DR
LCD_LCDPort__INP_DIS EQU CYREG_PRT2_INP_DIS
LCD_LCDPort__LCD_COM_SEG EQU CYREG_PRT2_LCD_COM_SEG
LCD_LCDPort__LCD_EN EQU CYREG_PRT2_LCD_EN
LCD_LCDPort__MASK EQU 0x7F
LCD_LCDPort__PORT EQU 2
LCD_LCDPort__PRT EQU CYREG_PRT2_PRT
LCD_LCDPort__PRTDSI__CAPS_SEL EQU CYREG_PRT2_CAPS_SEL
LCD_LCDPort__PRTDSI__DBL_SYNC_IN EQU CYREG_PRT2_DBL_SYNC_IN
LCD_LCDPort__PRTDSI__OE_SEL0 EQU CYREG_PRT2_OE_SEL0
LCD_LCDPort__PRTDSI__OE_SEL1 EQU CYREG_PRT2_OE_SEL1
LCD_LCDPort__PRTDSI__OUT_SEL0 EQU CYREG_PRT2_OUT_SEL0
LCD_LCDPort__PRTDSI__OUT_SEL1 EQU CYREG_PRT2_OUT_SEL1
LCD_LCDPort__PRTDSI__SYNC_OUT EQU CYREG_PRT2_SYNC_OUT
LCD_LCDPort__PS EQU CYREG_PRT2_PS
LCD_LCDPort__SHIFT EQU 0
LCD_LCDPort__SLW EQU CYREG_PRT2_SLW

; Spedometer
Spedometer__0__MASK EQU 0x20
Spedometer__0__PC EQU CYREG_PRT6_PC5
Spedometer__0__PORT EQU 6
Spedometer__0__SHIFT EQU 5
Spedometer__AG EQU CYREG_PRT6_AG
Spedometer__AMUX EQU CYREG_PRT6_AMUX
Spedometer__BIE EQU CYREG_PRT6_BIE
Spedometer__BIT_MASK EQU CYREG_PRT6_BIT_MASK
Spedometer__BYP EQU CYREG_PRT6_BYP
Spedometer__CTL EQU CYREG_PRT6_CTL
Spedometer__DM0 EQU CYREG_PRT6_DM0
Spedometer__DM1 EQU CYREG_PRT6_DM1
Spedometer__DM2 EQU CYREG_PRT6_DM2
Spedometer__DR EQU CYREG_PRT6_DR
Spedometer__INP_DIS EQU CYREG_PRT6_INP_DIS
Spedometer__LCD_COM_SEG EQU CYREG_PRT6_LCD_COM_SEG
Spedometer__LCD_EN EQU CYREG_PRT6_LCD_EN
Spedometer__MASK EQU 0x20
Spedometer__PORT EQU 6
Spedometer__PRT EQU CYREG_PRT6_PRT
Spedometer__PRTDSI__CAPS_SEL EQU CYREG_PRT6_CAPS_SEL
Spedometer__PRTDSI__DBL_SYNC_IN EQU CYREG_PRT6_DBL_SYNC_IN
Spedometer__PRTDSI__OE_SEL0 EQU CYREG_PRT6_OE_SEL0
Spedometer__PRTDSI__OE_SEL1 EQU CYREG_PRT6_OE_SEL1
Spedometer__PRTDSI__OUT_SEL0 EQU CYREG_PRT6_OUT_SEL0
Spedometer__PRTDSI__OUT_SEL1 EQU CYREG_PRT6_OUT_SEL1
Spedometer__PRTDSI__SYNC_OUT EQU CYREG_PRT6_SYNC_OUT
Spedometer__PS EQU CYREG_PRT6_PS
Spedometer__SHIFT EQU 5
Spedometer__SLW EQU CYREG_PRT6_SLW

; ADC_DSM4
ADC_DSM4__BUF0 EQU CYREG_DSM0_BUF0
ADC_DSM4__BUF1 EQU CYREG_DSM0_BUF1
ADC_DSM4__BUF2 EQU CYREG_DSM0_BUF2
ADC_DSM4__BUF3 EQU CYREG_DSM0_BUF3
ADC_DSM4__CLK EQU CYREG_DSM0_CLK
ADC_DSM4__CR0 EQU CYREG_DSM0_CR0
ADC_DSM4__CR1 EQU CYREG_DSM0_CR1
ADC_DSM4__CR10 EQU CYREG_DSM0_CR10
ADC_DSM4__CR11 EQU CYREG_DSM0_CR11
ADC_DSM4__CR12 EQU CYREG_DSM0_CR12
ADC_DSM4__CR13 EQU CYREG_DSM0_CR13
ADC_DSM4__CR14 EQU CYREG_DSM0_CR14
ADC_DSM4__CR15 EQU CYREG_DSM0_CR15
ADC_DSM4__CR16 EQU CYREG_DSM0_CR16
ADC_DSM4__CR17 EQU CYREG_DSM0_CR17
ADC_DSM4__CR2 EQU CYREG_DSM0_CR2
ADC_DSM4__CR3 EQU CYREG_DSM0_CR3
ADC_DSM4__CR4 EQU CYREG_DSM0_CR4
ADC_DSM4__CR5 EQU CYREG_DSM0_CR5
ADC_DSM4__CR6 EQU CYREG_DSM0_CR6
ADC_DSM4__CR7 EQU CYREG_DSM0_CR7
ADC_DSM4__CR8 EQU CYREG_DSM0_CR8
ADC_DSM4__CR9 EQU CYREG_DSM0_CR9
ADC_DSM4__DEM0 EQU CYREG_DSM0_DEM0
ADC_DSM4__DEM1 EQU CYREG_DSM0_DEM1
ADC_DSM4__MISC EQU CYREG_DSM0_MISC
ADC_DSM4__OUT0 EQU CYREG_DSM0_OUT0
ADC_DSM4__OUT1 EQU CYREG_DSM0_OUT1
ADC_DSM4__REF0 EQU CYREG_DSM0_REF0
ADC_DSM4__REF1 EQU CYREG_DSM0_REF1
ADC_DSM4__REF2 EQU CYREG_DSM0_REF2
ADC_DSM4__REF3 EQU CYREG_DSM0_REF3
ADC_DSM4__RSVD1 EQU CYREG_DSM0_RSVD1
ADC_DSM4__SW0 EQU CYREG_DSM0_SW0
ADC_DSM4__SW2 EQU CYREG_DSM0_SW2
ADC_DSM4__SW3 EQU CYREG_DSM0_SW3
ADC_DSM4__SW4 EQU CYREG_DSM0_SW4
ADC_DSM4__SW6 EQU CYREG_DSM0_SW6
ADC_DSM4__TR0 EQU CYREG_NPUMP_DSM_TR0
ADC_DSM4__TST0 EQU CYREG_DSM0_TST0
ADC_DSM4__TST1 EQU CYREG_DSM0_TST1

; ADC_DEC
ADC_DEC__COHER EQU CYREG_DEC_COHER
ADC_DEC__CR EQU CYREG_DEC_CR
ADC_DEC__DR1 EQU CYREG_DEC_DR1
ADC_DEC__DR2 EQU CYREG_DEC_DR2
ADC_DEC__DR2H EQU CYREG_DEC_DR2H
ADC_DEC__GCOR EQU CYREG_DEC_GCOR
ADC_DEC__GCORH EQU CYREG_DEC_GCORH
ADC_DEC__GVAL EQU CYREG_DEC_GVAL
ADC_DEC__OCOR EQU CYREG_DEC_OCOR
ADC_DEC__OCORH EQU CYREG_DEC_OCORH
ADC_DEC__OCORM EQU CYREG_DEC_OCORM
ADC_DEC__OUTSAMP EQU CYREG_DEC_OUTSAMP
ADC_DEC__OUTSAMPH EQU CYREG_DEC_OUTSAMPH
ADC_DEC__OUTSAMPM EQU CYREG_DEC_OUTSAMPM
ADC_DEC__OUTSAMPS EQU CYREG_DEC_OUTSAMPS
ADC_DEC__PM_ACT_CFG EQU CYREG_PM_ACT_CFG10
ADC_DEC__PM_ACT_MSK EQU 0x01
ADC_DEC__PM_STBY_CFG EQU CYREG_PM_STBY_CFG10
ADC_DEC__PM_STBY_MSK EQU 0x01
ADC_DEC__SHIFT1 EQU CYREG_DEC_SHIFT1
ADC_DEC__SHIFT2 EQU CYREG_DEC_SHIFT2
ADC_DEC__SR EQU CYREG_DEC_SR
ADC_DEC__TRIM__M1 EQU CYREG_FLSHID_CUST_TABLES_DEC_M1
ADC_DEC__TRIM__M2 EQU CYREG_FLSHID_CUST_TABLES_DEC_M2
ADC_DEC__TRIM__M3 EQU CYREG_FLSHID_CUST_TABLES_DEC_M3
ADC_DEC__TRIM__M4 EQU CYREG_FLSHID_CUST_TABLES_DEC_M4
ADC_DEC__TRIM__M5 EQU CYREG_FLSHID_CUST_TABLES_DEC_M5
ADC_DEC__TRIM__M6 EQU CYREG_FLSHID_CUST_TABLES_DEC_M6
ADC_DEC__TRIM__M7 EQU CYREG_FLSHID_CUST_TABLES_DEC_M7
ADC_DEC__TRIM__M8 EQU CYREG_FLSHID_CUST_TABLES_DEC_M8

; ADC_IRQ
ADC_IRQ__INTC_CLR_EN_REG EQU CYREG_NVIC_CLRENA0
ADC_IRQ__INTC_CLR_PD_REG EQU CYREG_NVIC_CLRPEND0
ADC_IRQ__INTC_MASK EQU 0x20000000
ADC_IRQ__INTC_NUMBER EQU 29
ADC_IRQ__INTC_PRIOR_NUM EQU 7
ADC_IRQ__INTC_PRIOR_REG EQU CYREG_NVIC_PRI_29
ADC_IRQ__INTC_SET_EN_REG EQU CYREG_NVIC_SETENA0
ADC_IRQ__INTC_SET_PD_REG EQU CYREG_NVIC_SETPEND0

; Shifter
Shifter__0__MASK EQU 0x08
Shifter__0__PC EQU CYREG_PRT4_PC3
Shifter__0__PORT EQU 4
Shifter__0__SHIFT EQU 3
Shifter__AG EQU CYREG_PRT4_AG
Shifter__AMUX EQU CYREG_PRT4_AMUX
Shifter__BIE EQU CYREG_PRT4_BIE
Shifter__BIT_MASK EQU CYREG_PRT4_BIT_MASK
Shifter__BYP EQU CYREG_PRT4_BYP
Shifter__CTL EQU CYREG_PRT4_CTL
Shifter__DM0 EQU CYREG_PRT4_DM0
Shifter__DM1 EQU CYREG_PRT4_DM1
Shifter__DM2 EQU CYREG_PRT4_DM2
Shifter__DR EQU CYREG_PRT4_DR
Shifter__INP_DIS EQU CYREG_PRT4_INP_DIS
Shifter__LCD_COM_SEG EQU CYREG_PRT4_LCD_COM_SEG
Shifter__LCD_EN EQU CYREG_PRT4_LCD_EN
Shifter__MASK EQU 0x08
Shifter__PORT EQU 4
Shifter__PRT EQU CYREG_PRT4_PRT
Shifter__PRTDSI__CAPS_SEL EQU CYREG_PRT4_CAPS_SEL
Shifter__PRTDSI__DBL_SYNC_IN EQU CYREG_PRT4_DBL_SYNC_IN
Shifter__PRTDSI__OE_SEL0 EQU CYREG_PRT4_OE_SEL0
Shifter__PRTDSI__OE_SEL1 EQU CYREG_PRT4_OE_SEL1
Shifter__PRTDSI__OUT_SEL0 EQU CYREG_PRT4_OUT_SEL0
Shifter__PRTDSI__OUT_SEL1 EQU CYREG_PRT4_OUT_SEL1
Shifter__PRTDSI__SYNC_OUT EQU CYREG_PRT4_SYNC_OUT
Shifter__PS EQU CYREG_PRT4_PS
Shifter__SHIFT EQU 3
Shifter__SLW EQU CYREG_PRT4_SLW

; Colors
Colors__0__MASK EQU 0x10
Colors__0__PC EQU CYREG_PRT4_PC4
Colors__0__PORT EQU 4
Colors__0__SHIFT EQU 4
Colors__AG EQU CYREG_PRT4_AG
Colors__AMUX EQU CYREG_PRT4_AMUX
Colors__BIE EQU CYREG_PRT4_BIE
Colors__BIT_MASK EQU CYREG_PRT4_BIT_MASK
Colors__BYP EQU CYREG_PRT4_BYP
Colors__CTL EQU CYREG_PRT4_CTL
Colors__DM0 EQU CYREG_PRT4_DM0
Colors__DM1 EQU CYREG_PRT4_DM1
Colors__DM2 EQU CYREG_PRT4_DM2
Colors__DR EQU CYREG_PRT4_DR
Colors__INP_DIS EQU CYREG_PRT4_INP_DIS
Colors__LCD_COM_SEG EQU CYREG_PRT4_LCD_COM_SEG
Colors__LCD_EN EQU CYREG_PRT4_LCD_EN
Colors__MASK EQU 0x10
Colors__PORT EQU 4
Colors__PRT EQU CYREG_PRT4_PRT
Colors__PRTDSI__CAPS_SEL EQU CYREG_PRT4_CAPS_SEL
Colors__PRTDSI__DBL_SYNC_IN EQU CYREG_PRT4_DBL_SYNC_IN
Colors__PRTDSI__OE_SEL0 EQU CYREG_PRT4_OE_SEL0
Colors__PRTDSI__OE_SEL1 EQU CYREG_PRT4_OE_SEL1
Colors__PRTDSI__OUT_SEL0 EQU CYREG_PRT4_OUT_SEL0
Colors__PRTDSI__OUT_SEL1 EQU CYREG_PRT4_OUT_SEL1
Colors__PRTDSI__SYNC_OUT EQU CYREG_PRT4_SYNC_OUT
Colors__PS EQU CYREG_PRT4_PS
Colors__SHIFT EQU 4
Colors__SLW EQU CYREG_PRT4_SLW

; Error
Error__0__MASK EQU 0x04
Error__0__PC EQU CYREG_PRT6_PC2
Error__0__PORT EQU 6
Error__0__SHIFT EQU 2
Error__AG EQU CYREG_PRT6_AG
Error__AMUX EQU CYREG_PRT6_AMUX
Error__BIE EQU CYREG_PRT6_BIE
Error__BIT_MASK EQU CYREG_PRT6_BIT_MASK
Error__BYP EQU CYREG_PRT6_BYP
Error__CTL EQU CYREG_PRT6_CTL
Error__DM0 EQU CYREG_PRT6_DM0
Error__DM1 EQU CYREG_PRT6_DM1
Error__DM2 EQU CYREG_PRT6_DM2
Error__DR EQU CYREG_PRT6_DR
Error__INP_DIS EQU CYREG_PRT6_INP_DIS
Error__LCD_COM_SEG EQU CYREG_PRT6_LCD_COM_SEG
Error__LCD_EN EQU CYREG_PRT6_LCD_EN
Error__MASK EQU 0x04
Error__PORT EQU 6
Error__PRT EQU CYREG_PRT6_PRT
Error__PRTDSI__CAPS_SEL EQU CYREG_PRT6_CAPS_SEL
Error__PRTDSI__DBL_SYNC_IN EQU CYREG_PRT6_DBL_SYNC_IN
Error__PRTDSI__OE_SEL0 EQU CYREG_PRT6_OE_SEL0
Error__PRTDSI__OE_SEL1 EQU CYREG_PRT6_OE_SEL1
Error__PRTDSI__OUT_SEL0 EQU CYREG_PRT6_OUT_SEL0
Error__PRTDSI__OUT_SEL1 EQU CYREG_PRT6_OUT_SEL1
Error__PRTDSI__SYNC_OUT EQU CYREG_PRT6_SYNC_OUT
Error__PS EQU CYREG_PRT6_PS
Error__SHIFT EQU 2
Error__SLW EQU CYREG_PRT6_SLW

; Green
Green__0__MASK EQU 0x40
Green__0__PC EQU CYREG_PRT4_PC6
Green__0__PORT EQU 4
Green__0__SHIFT EQU 6
Green__AG EQU CYREG_PRT4_AG
Green__AMUX EQU CYREG_PRT4_AMUX
Green__BIE EQU CYREG_PRT4_BIE
Green__BIT_MASK EQU CYREG_PRT4_BIT_MASK
Green__BYP EQU CYREG_PRT4_BYP
Green__CTL EQU CYREG_PRT4_CTL
Green__DM0 EQU CYREG_PRT4_DM0
Green__DM1 EQU CYREG_PRT4_DM1
Green__DM2 EQU CYREG_PRT4_DM2
Green__DR EQU CYREG_PRT4_DR
Green__INP_DIS EQU CYREG_PRT4_INP_DIS
Green__LCD_COM_SEG EQU CYREG_PRT4_LCD_COM_SEG
Green__LCD_EN EQU CYREG_PRT4_LCD_EN
Green__MASK EQU 0x40
Green__PORT EQU 4
Green__PRT EQU CYREG_PRT4_PRT
Green__PRTDSI__CAPS_SEL EQU CYREG_PRT4_CAPS_SEL
Green__PRTDSI__DBL_SYNC_IN EQU CYREG_PRT4_DBL_SYNC_IN
Green__PRTDSI__OE_SEL0 EQU CYREG_PRT4_OE_SEL0
Green__PRTDSI__OE_SEL1 EQU CYREG_PRT4_OE_SEL1
Green__PRTDSI__OUT_SEL0 EQU CYREG_PRT4_OUT_SEL0
Green__PRTDSI__OUT_SEL1 EQU CYREG_PRT4_OUT_SEL1
Green__PRTDSI__SYNC_OUT EQU CYREG_PRT4_SYNC_OUT
Green__PS EQU CYREG_PRT4_PS
Green__SHIFT EQU 6
Green__SLW EQU CYREG_PRT4_SLW

; Beam
Beam__INTC_CLR_EN_REG EQU CYREG_NVIC_CLRENA0
Beam__INTC_CLR_PD_REG EQU CYREG_NVIC_CLRPEND0
Beam__INTC_MASK EQU 0x01
Beam__INTC_NUMBER EQU 0
Beam__INTC_PRIOR_NUM EQU 7
Beam__INTC_PRIOR_REG EQU CYREG_NVIC_PRI_0
Beam__INTC_SET_EN_REG EQU CYREG_NVIC_SETENA0
Beam__INTC_SET_PD_REG EQU CYREG_NVIC_SETPEND0

; Blue
Blue__0__MASK EQU 0x80
Blue__0__PC EQU CYREG_PRT4_PC7
Blue__0__PORT EQU 4
Blue__0__SHIFT EQU 7
Blue__AG EQU CYREG_PRT4_AG
Blue__AMUX EQU CYREG_PRT4_AMUX
Blue__BIE EQU CYREG_PRT4_BIE
Blue__BIT_MASK EQU CYREG_PRT4_BIT_MASK
Blue__BYP EQU CYREG_PRT4_BYP
Blue__CTL EQU CYREG_PRT4_CTL
Blue__DM0 EQU CYREG_PRT4_DM0
Blue__DM1 EQU CYREG_PRT4_DM1
Blue__DM2 EQU CYREG_PRT4_DM2
Blue__DR EQU CYREG_PRT4_DR
Blue__INP_DIS EQU CYREG_PRT4_INP_DIS
Blue__LCD_COM_SEG EQU CYREG_PRT4_LCD_COM_SEG
Blue__LCD_EN EQU CYREG_PRT4_LCD_EN
Blue__MASK EQU 0x80
Blue__PORT EQU 4
Blue__PRT EQU CYREG_PRT4_PRT
Blue__PRTDSI__CAPS_SEL EQU CYREG_PRT4_CAPS_SEL
Blue__PRTDSI__DBL_SYNC_IN EQU CYREG_PRT4_DBL_SYNC_IN
Blue__PRTDSI__OE_SEL0 EQU CYREG_PRT4_OE_SEL0
Blue__PRTDSI__OE_SEL1 EQU CYREG_PRT4_OE_SEL1
Blue__PRTDSI__OUT_SEL0 EQU CYREG_PRT4_OUT_SEL0
Blue__PRTDSI__OUT_SEL1 EQU CYREG_PRT4_OUT_SEL1
Blue__PRTDSI__SYNC_OUT EQU CYREG_PRT4_SYNC_OUT
Blue__PS EQU CYREG_PRT4_PS
Blue__SHIFT EQU 7
Blue__SLW EQU CYREG_PRT4_SLW

; Red
Red__0__MASK EQU 0x20
Red__0__PC EQU CYREG_PRT4_PC5
Red__0__PORT EQU 4
Red__0__SHIFT EQU 5
Red__AG EQU CYREG_PRT4_AG
Red__AMUX EQU CYREG_PRT4_AMUX
Red__BIE EQU CYREG_PRT4_BIE
Red__BIT_MASK EQU CYREG_PRT4_BIT_MASK
Red__BYP EQU CYREG_PRT4_BYP
Red__CTL EQU CYREG_PRT4_CTL
Red__DM0 EQU CYREG_PRT4_DM0
Red__DM1 EQU CYREG_PRT4_DM1
Red__DM2 EQU CYREG_PRT4_DM2
Red__DR EQU CYREG_PRT4_DR
Red__INP_DIS EQU CYREG_PRT4_INP_DIS
Red__LCD_COM_SEG EQU CYREG_PRT4_LCD_COM_SEG
Red__LCD_EN EQU CYREG_PRT4_LCD_EN
Red__MASK EQU 0x20
Red__PORT EQU 4
Red__PRT EQU CYREG_PRT4_PRT
Red__PRTDSI__CAPS_SEL EQU CYREG_PRT4_CAPS_SEL
Red__PRTDSI__DBL_SYNC_IN EQU CYREG_PRT4_DBL_SYNC_IN
Red__PRTDSI__OE_SEL0 EQU CYREG_PRT4_OE_SEL0
Red__PRTDSI__OE_SEL1 EQU CYREG_PRT4_OE_SEL1
Red__PRTDSI__OUT_SEL0 EQU CYREG_PRT4_OUT_SEL0
Red__PRTDSI__OUT_SEL1 EQU CYREG_PRT4_OUT_SEL1
Red__PRTDSI__SYNC_OUT EQU CYREG_PRT4_SYNC_OUT
Red__PS EQU CYREG_PRT4_PS
Red__SHIFT EQU 5
Red__SLW EQU CYREG_PRT4_SLW

; Row
Row__0__MASK EQU 0x04
Row__0__PC EQU CYREG_PRT4_PC2
Row__0__PORT EQU 4
Row__0__SHIFT EQU 2
Row__AG EQU CYREG_PRT4_AG
Row__AMUX EQU CYREG_PRT4_AMUX
Row__BIE EQU CYREG_PRT4_BIE
Row__BIT_MASK EQU CYREG_PRT4_BIT_MASK
Row__BYP EQU CYREG_PRT4_BYP
Row__CTL EQU CYREG_PRT4_CTL
Row__DM0 EQU CYREG_PRT4_DM0
Row__DM1 EQU CYREG_PRT4_DM1
Row__DM2 EQU CYREG_PRT4_DM2
Row__DR EQU CYREG_PRT4_DR
Row__INP_DIS EQU CYREG_PRT4_INP_DIS
Row__LCD_COM_SEG EQU CYREG_PRT4_LCD_COM_SEG
Row__LCD_EN EQU CYREG_PRT4_LCD_EN
Row__MASK EQU 0x04
Row__PORT EQU 4
Row__PRT EQU CYREG_PRT4_PRT
Row__PRTDSI__CAPS_SEL EQU CYREG_PRT4_CAPS_SEL
Row__PRTDSI__DBL_SYNC_IN EQU CYREG_PRT4_DBL_SYNC_IN
Row__PRTDSI__OE_SEL0 EQU CYREG_PRT4_OE_SEL0
Row__PRTDSI__OE_SEL1 EQU CYREG_PRT4_OE_SEL1
Row__PRTDSI__OUT_SEL0 EQU CYREG_PRT4_OUT_SEL0
Row__PRTDSI__OUT_SEL1 EQU CYREG_PRT4_OUT_SEL1
Row__PRTDSI__SYNC_OUT EQU CYREG_PRT4_SYNC_OUT
Row__PS EQU CYREG_PRT4_PS
Row__SHIFT EQU 2
Row__SLW EQU CYREG_PRT4_SLW

; Miscellaneous
; -- WARNING: define names containing LEOPARD or PANTHER are deprecated and will be removed in a future release
CYDEV_DEBUGGING_DPS_SWD_SWV EQU 6
CYDEV_CONFIG_UNUSED_IO_AllowButWarn EQU 0
CYDEV_CONFIGURATION_MODE_COMPRESSED EQU 0
CYDEV_CONFIG_FASTBOOT_ENABLED EQU 1
CYDEV_CHIP_REV_PSOC5LP_PRODUCTION EQU 0
CYDEV_CHIP_REVISION_5B_PRODUCTION EQU 0
CYDEV_CHIP_MEMBER_5B EQU 4
CYDEV_CHIP_FAMILY_PSOC5 EQU 3
CYDEV_CHIP_DIE_PSOC5LP EQU 4
CYDEV_CHIP_DIE_EXPECT EQU CYDEV_CHIP_DIE_PSOC5LP
BCLK__BUS_CLK__HZ EQU 24000000
BCLK__BUS_CLK__KHZ EQU 24000
BCLK__BUS_CLK__MHZ EQU 24
CYDEV_CHIP_DIE_ACTUAL EQU CYDEV_CHIP_DIE_EXPECT
CYDEV_CHIP_DIE_LEOPARD EQU 1
CYDEV_CHIP_DIE_PANTHER EQU 3
CYDEV_CHIP_DIE_PSOC4A EQU 2
CYDEV_CHIP_DIE_UNKNOWN EQU 0
CYDEV_CHIP_FAMILY_PSOC3 EQU 1
CYDEV_CHIP_FAMILY_PSOC4 EQU 2
CYDEV_CHIP_FAMILY_UNKNOWN EQU 0
CYDEV_CHIP_FAMILY_USED EQU CYDEV_CHIP_FAMILY_PSOC5
CYDEV_CHIP_JTAG_ID EQU 0x2E123069
CYDEV_CHIP_MEMBER_3A EQU 1
CYDEV_CHIP_MEMBER_4A EQU 2
CYDEV_CHIP_MEMBER_5A EQU 3
CYDEV_CHIP_MEMBER_UNKNOWN EQU 0
CYDEV_CHIP_MEMBER_USED EQU CYDEV_CHIP_MEMBER_5B
CYDEV_CHIP_REVISION_3A_ES1 EQU 0
CYDEV_CHIP_REVISION_3A_ES2 EQU 1
CYDEV_CHIP_REVISION_3A_ES3 EQU 3
CYDEV_CHIP_REVISION_3A_PRODUCTION EQU 3
CYDEV_CHIP_REVISION_4A_ES0 EQU 17
CYDEV_CHIP_REVISION_4A_PRODUCTION EQU 17
CYDEV_CHIP_REVISION_5A_ES0 EQU 0
CYDEV_CHIP_REVISION_5A_ES1 EQU 1
CYDEV_CHIP_REVISION_5A_PRODUCTION EQU 1
CYDEV_CHIP_REVISION_5B_ES0 EQU 0
CYDEV_CHIP_REVISION_USED EQU CYDEV_CHIP_REVISION_5B_PRODUCTION
CYDEV_CHIP_REV_EXPECT EQU CYDEV_CHIP_REV_PSOC5LP_PRODUCTION
CYDEV_CHIP_REV_LEOPARD_ES1 EQU 0
CYDEV_CHIP_REV_LEOPARD_ES2 EQU 1
CYDEV_CHIP_REV_LEOPARD_ES3 EQU 3
CYDEV_CHIP_REV_LEOPARD_PRODUCTION EQU 3
CYDEV_CHIP_REV_PANTHER_ES0 EQU 0
CYDEV_CHIP_REV_PANTHER_ES1 EQU 1
CYDEV_CHIP_REV_PANTHER_PRODUCTION EQU 1
CYDEV_CHIP_REV_PSOC4A_ES0 EQU 17
CYDEV_CHIP_REV_PSOC4A_PRODUCTION EQU 17
CYDEV_CHIP_REV_PSOC5LP_ES0 EQU 0
CYDEV_CONFIGURATION_COMPRESSED EQU 1
CYDEV_CONFIGURATION_DMA EQU 0
CYDEV_CONFIGURATION_ECC EQU 1
CYDEV_CONFIGURATION_IMOENABLED EQU CYDEV_CONFIG_FASTBOOT_ENABLED
CYDEV_CONFIGURATION_MODE EQU CYDEV_CONFIGURATION_MODE_COMPRESSED
CYDEV_CONFIGURATION_MODE_DMA EQU 2
CYDEV_CONFIGURATION_MODE_UNCOMPRESSED EQU 1
CYDEV_CONFIG_UNUSED_IO EQU CYDEV_CONFIG_UNUSED_IO_AllowButWarn
CYDEV_CONFIG_UNUSED_IO_AllowWithInfo EQU 1
CYDEV_CONFIG_UNUSED_IO_Disallowed EQU 2
CYDEV_DEBUGGING_DPS EQU CYDEV_DEBUGGING_DPS_SWD_SWV
CYDEV_DEBUGGING_DPS_Disable EQU 3
CYDEV_DEBUGGING_DPS_JTAG_4 EQU 1
CYDEV_DEBUGGING_DPS_JTAG_5 EQU 0
CYDEV_DEBUGGING_DPS_SWD EQU 2
CYDEV_DEBUGGING_ENABLE EQU 1
CYDEV_DEBUGGING_REQXRES EQU 1
CYDEV_DEBUGGING_XRES EQU 0
CYDEV_DEBUG_ENABLE_MASK EQU 0x20
CYDEV_DEBUG_ENABLE_REGISTER EQU CYREG_MLOGIC_DEBUG
CYDEV_DMA_CHANNELS_AVAILABLE EQU 24
CYDEV_ECC_ENABLE EQU 0
CYDEV_HEAP_SIZE EQU 0x1000
CYDEV_INSTRUCT_CACHE_ENABLED EQU 1
CYDEV_INTR_RISING EQU 0x00000000
CYDEV_PROJ_TYPE EQU 0
CYDEV_PROJ_TYPE_BOOTLOADER EQU 1
CYDEV_PROJ_TYPE_LOADABLE EQU 2
CYDEV_PROJ_TYPE_MULTIAPPBOOTLOADER EQU 3
CYDEV_PROJ_TYPE_STANDARD EQU 0
CYDEV_PROTECTION_ENABLE EQU 0
CYDEV_STACK_SIZE EQU 0x4000
CYDEV_USE_BUNDLED_CMSIS EQU 1
CYDEV_VARIABLE_VDDA EQU 0
CYDEV_VDDA_MV EQU 5000
CYDEV_VDDD_MV EQU 5000
CYDEV_VDDIO0_MV EQU 5000
CYDEV_VDDIO1_MV EQU 5000
CYDEV_VDDIO2_MV EQU 5000
CYDEV_VDDIO3_MV EQU 5000
CYDEV_VIO0 EQU 5
CYDEV_VIO0_MV EQU 5000
CYDEV_VIO1 EQU 5
CYDEV_VIO1_MV EQU 5000
CYDEV_VIO2 EQU 5
CYDEV_VIO2_MV EQU 5000
CYDEV_VIO3 EQU 5
CYDEV_VIO3_MV EQU 5000
DMA_CHANNELS_USED__MASK0 EQU 0x00000000
CYDEV_BOOTLOADER_ENABLE EQU 0
    ENDIF
    END
